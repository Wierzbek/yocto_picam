## poky-honister/meta-picam/conf/layer.conf
```bitbake
# We have a conf and classes directory, add to BBPATH
BBPATH .= ":${LAYERDIR}"

# We have recipes-* directories, add to BBFILES
BBFILES += "${LAYERDIR}/recipes-*/*/*.bb \
            ${LAYERDIR}/recipes-*/*/*.bbappend"

BBFILE_COLLECTIONS += "meta-picam"
BBFILE_PATTERN_meta-picam = "^${LAYERDIR}/"
BBFILE_PRIORITY_meta-picam = "6"

LAYERDEPENDS_meta-picam = "core"
LAYERSERIES_COMPAT_meta-picam = "honister"
```

## rpi-build/conf/bblayers.conf
```bitbake
# POKY_BBLAYERS_CONF_VERSION is increased each time build/conf/bblayers.conf
# changes incompatibly
POKY_BBLAYERS_CONF_VERSION = "2"

BBPATH = "${TOPDIR}"
BBFILES ?= ""

BBLAYERS ?= " \
  /home/Projects/poky-honister/meta \
  /home/Projects/poky-honister/meta-poky \
  /home/Projects/poky-honister/meta-yocto-bsp \
  /home/Projects/poky-honister/meta-raspberrypi \
  /home/Projects/poky-honister/meta-picam \
  "
```
